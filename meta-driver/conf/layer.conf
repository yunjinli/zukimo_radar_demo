## meta-driver/conf/layer.conf
```bitbake
# We have a conf and classes directory, add to BBPATH
BBPATH .= ":${LAYERDIR}"

# We have recipes-* directories, add to BBFILES
BBFILES += "${LAYERDIR}/recipes-*/*/*.bb \
            ${LAYERDIR}/recipes-*/*/*.bbappend"

BBFILE_COLLECTIONS += "meta-driver"
BBFILE_PATTERN_meta-driver = "^${LAYERDIR}/"
BBFILE_PRIORITY_meta-driver = "6"

LAYERDEPENDS_meta-driver = "core"
LAYERSERIES_COMPAT_meta-driver = "nanbield"
```

## meta-ims/conf/layer.conf
```bitbake
# Layer configuration for meta-ims

BBPATH .= ":${LAYERDIR}"
BBFILES += "${LAYERDIR}/recipes*/*/*.bb ${LAYERDIR}/recipes*/*/*.bbappend"


BBFILE_COLLECTIONS += "ims-layer"
BBFILE_PATTERN_ims-layer := "^${LAYERDIR}/"
# Zukimo layer is priority 50, so we need to be higher
BBFILE_PRIORITY_ims-layer = "100"

LAYERDEPENDS_ims-layer = "core"
LAYERSERIES_COMPAT_ims-layer = "nanbield"


# The src and revision for the spa_ml_driver repository
# https://gitlab.projekt.uni-hannover.de/ims-zuse-ki-mobil/spa_ml_driver
GITSRC_SPA_ML_DRIVER ?= "git://git@gitlab.projekt.uni-hannover.de/ims-zuse-ki-mobil/spa_ml_driver.git;branch=wip_develop;protocol=ssh"
GITREV_SPA_ML_DRIVER ?= "e8c0b5a24009e03557662caa41ad69862b229fa8"
```
